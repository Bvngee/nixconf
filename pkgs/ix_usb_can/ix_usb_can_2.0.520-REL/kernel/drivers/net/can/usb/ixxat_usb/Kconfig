## pkgs/ix_usb_can/ix_usb_can_2.0.520-REL/kernel/drivers/net/can/usb/ixxat_usb/Kconfig
```kconfig
# SPDX-License-Identifier: GPL-2.0-only
config CAN_IXXAT_USB
	tristate "IXXAT USB-to-CAN interfaces"
	help
	  This driver adds support for IXXAT USB-to-CAN devices.

	  The driver provides support for the following devices:
	    - IXXAT USB-to-CAN compact
	    - IXXAT USB-to-CAN embedded
	    - IXXAT USB-to-CAN professional
	    - IXXAT USB-to-CAN automotive
	    - IXXAT USB-to-CAN FD compact
	    - IXXAT USB-to-CAN FD professional
	    - IXXAT USB-to-CAN FD automotive
	    - IXXAT USB-to-CAN FD MiniPCIe
	    - IXXAT USB-to-CAR
	    - IXXAT CAN-IDM101
```
